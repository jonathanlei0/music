#include <Adafruit_NeoPixel.h>
#include "mirrored_neopixel.h"
#if !defined(__AVR_ATmega328P__)
#error "Select Arduino Uno (ATmega328P)."
#endif
constexpr uint8_t PINS[] = {5, 6, 7, 4};
constexpr uint16_t NUM_LEDS = 300, FRAME_BYTES = NUM_LEDS * 3;
// Match this to the actual combined supply/wiring budget before expanding effects.
constexpr uint32_t MAX_MILLIAMPS = 60000UL;
MirroredNeoPixel strip(NUM_LEDS, PINS[0], NEO_GRB + NEO_KHZ800);
uint8_t state = 0, matched = 0, header[4];
uint16_t pixelOffset = 0;
uint8_t channel = 0;
uint16_t index = 0, crc = 0xffff, receivedCrc = 0, sequence = 0;
unsigned long lastByte = 0, lastFrame = 0;
bool lit = false;

const uint16_t CRC_TABLE[256] PROGMEM = {
0x0,0x1021,0x2042,0x3063,0x4084,0x50a5,0x60c6,0x70e7,0x8108,0x9129,0xa14a,0xb16b,0xc18c,0xd1ad,0xe1ce,0xf1ef,
0x1231,0x210,0x3273,0x2252,0x52b5,0x4294,0x72f7,0x62d6,0x9339,0x8318,0xb37b,0xa35a,0xd3bd,0xc39c,0xf3ff,0xe3de,
0x2462,0x3443,0x420,0x1401,0x64e6,0x74c7,0x44a4,0x5485,0xa56a,0xb54b,0x8528,0x9509,0xe5ee,0xf5cf,0xc5ac,0xd58d,
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0xef1f,0xff3e,0xcf5d,0xdf7c,0xaf9b,0xbfba,0x8fd9,0x9ff8,0x6e17,0x7e36,0x4e55,0x5e74,0x2e93,0x3eb2,0xed1,0x1ef0
};
uint16_t crcByte(uint16_t value, uint8_t c) {
  return (value << 8) ^ pgm_read_word(CRC_TABLE + ((value >> 8) ^ c));
}
void resetParser() { state=matched=0; index=0; crc=0xffff; }
void publish() {
  // Last-resort current cap on the composed frame; no effects run here.
  uint8_t *pixels=strip.getPixels();
  uint32_t sum=0;
  for (uint16_t i=0;i<FRAME_BYTES;++i) sum+=pixels[i];
  uint32_t idle=(uint32_t)NUM_LEDS*4;
  uint32_t allowed=MAX_MILLIAMPS>idle ? (MAX_MILLIAMPS-idle)*255UL/(4UL*20UL) : 0;
  if (sum>allowed) {
    for (uint16_t i=0;i<FRAME_BYTES;++i) pixels[i]=(uint32_t)pixels[i]*allowed/sum;
  }
  strip.show();
  lit=sum!=0;
  lastFrame=millis();
}
void receiveByte(uint8_t c) {
  lastByte=millis();
  if (!state) {
    const char magic[]="RGB1";
    if (c==magic[matched]) ++matched;
    else matched=c=='R' ? 1 : 0;
    if (matched==4) { state=1; index=0; crc=0xffff; }
  } else if (state==1) {
    header[index++]=c; crc=crcByte(crc,c);
    if (index==4) {
      sequence=(uint16_t)header[0]|((uint16_t)header[1]<<8);
      uint16_t length=(uint16_t)header[2]|((uint16_t)header[3]<<8);
      if (length!=FRAME_BYTES) { resetParser(); return; }
      state=2; index=0; pixelOffset=0; channel=0;
    }
  } else if (state==2) {
    // Wire RGB -> NeoPixel's GRB buffer, with no second 900-byte allocation.
    strip.getPixels()[pixelOffset+(channel==0 ? 1 : channel==1 ? 0 : 2)]=c;
    if (++channel==3) { channel=0; pixelOffset+=3; }
    crc=crcByte(crc,c);
    if (++index==FRAME_BYTES) state=3;
  } else if (state==3) { receivedCrc=c; state=4; }
  else {
    receivedCrc|=(uint16_t)c<<8;
    if (receivedCrc==crc) { publish(); Serial.print("ACK,"); }
    else Serial.print("NAK,");
    Serial.println(sequence); // Host waits until show() has finished before sending.
    resetParser();
  }
}
void setup() {
  Serial.begin(500000);
  strip.begin(); strip.selectGroup(PINS,sizeof(PINS));
  strip.clear(); strip.show();
  Serial.println("READY_RGB1");
}
void loop() {
  if ((state || matched) && millis()-lastByte>100) resetParser();
  while (Serial.available()) receiveByte(Serial.read());
  if (lit && millis()-lastFrame>700) {
    strip.clear(); strip.show(); lit=false;
  }
}
